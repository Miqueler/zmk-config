## config/west.yml
```yaml
manifest:
  remotes:
    - name: zmkfirmware
      url-base: https://github.com/zmkfirmware

  projects:
    - name: zmk
      remote: zmkfirmware
      revision: main
      import: app/west.yml

    - name: zmk-nice-oled
      url: https://github.com/Miqueler/zmk-nice-oled-patched
      revision: main
      path: modules/zmk-nice-oled

  self:
    path: config
```
